## config/west.yml
```yaml
manifest:
  remotes:
    - name: zmkfirmware
      url-base: https://github.com/zmkfirmware
    - name: wjyoung65
      url-base: https://github.com/wjyoung65
  projects:
    - name: zmk
      remote: wjyoung65
      revision: adv360-z3
      import: app/west.yml
  self:
    path: config
```
